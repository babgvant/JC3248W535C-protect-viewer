#include "font.h"
// Antialiased 10x20 ASCII glyphs (font_data.c, generated by tools/gen_font.py).
extern const uint8_t font_alpha[95][FONT_W*FONT_H];
static bool portrait;
void overlay_set_portrait(bool value) {portrait=value;}
static int pixel_index(int x,int y) {
    // Landscape: native pixel (logical y, 479-logical x). Portrait: logical == native (320x480).
    int lw=portrait?320:480,lh=portrait?480:320;
    if(x<0||y<0||x>=lw||y>=lh) return -1;
    return portrait?y*320+x:(479-x)*320+y;
}
void overlay_rect(uint16_t *p,int x,int y,int w,int h,uint16_t color) {
    // Store big-endian RGB565 for LCD.
    color=(color>>8)|(color<<8);
    for(int yy=y;yy<y+h;yy++) for(int xx=x;xx<x+w;xx++) {
        int i=pixel_index(xx,yy); if(i>=0) p[i]=color;
    }
}
void overlay_text(uint16_t *p,int x,int y,const char *s,uint16_t c) {
    int cr=c>>11,cg=(c>>5)&63,cb=c&31;
    for(;*s&&x<(portrait?320-FONT_W:480-FONT_W);s++,x+=FONT_W) {
        unsigned ch=(unsigned char)*s; if(ch<32||ch>126) ch='?';
        const uint8_t *g=font_alpha[ch-32];
        for(int row=0;row<FONT_H;row++) for(int col=0;col<FONT_W;col++) {
            int a=g[row*FONT_W+col]; if(!a) continue;
            int i=pixel_index(x+col,y+row); if(i<0) continue;
            if(a<15) {
                uint16_t v=(p[i]>>8)|(p[i]<<8);
                int r=(v>>11)&31,gg=(v>>5)&63,b=v&31;
                r=(r*(15-a)+cr*a)/15; gg=(gg*(15-a)+cg*a)/15; b=(b*(15-a)+cb*a)/15;
                v=(r<<11)|(gg<<5)|b;
                p[i]=(v>>8)|(v<<8);
            } else p[i]=(c>>8)|(c<<8);
        }
    }
}
